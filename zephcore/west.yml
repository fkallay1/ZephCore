## zephcore/west.yml
```yaml
manifest:
  remotes:
    - name: zephyrproject-rtos
      url-base: https://github.com/zephyrproject-rtos

  projects:
    - name: zephyr
      remote: zephyrproject-rtos
      revision: b70dbaf045e06ee721316987df71c35d5a718693
      import: true

  self:
    path: zephcore
```
